## boards/shields/corne/Kconfig.shield
```kconfig
config SHIELD_CORNE_LEFT_PERIPHERAL
    def_bool $(shields_list_contains,sofle_left_peripheral)

config SHIELD_CORNE_DONGLE
    def_bool $(shields_list_contains,sofle_dongle)
```

## boards/shields/sofle/Kconfig.defconfig
```kconfig
if SHIELD_SOFLE_DONGLE

config ZMK_KEYBOARD_NAME
    default "OLED_Dongle"

config ZMK_SPLIT_ROLE_CENTRAL
    default y

# Set this to the number of peripherals your dongle will have.
# For a unibody, this would be 1. If you have left and right halves, set it to 2, etc.
config ZMK_SPLIT_BLE_CENTRAL_PERIPHERALS
    default 2

# Set this to ZMK_SPLIT_BLE_CENTRAL_PERIPHERALS + your desired number of BT profiles (default is 5)
config BT_MAX_CONN
    default 2

# Set this to the same number as BT_MAX_CONN
config BT_MAX_PAIRED
    default 2

endif

if SHIELD_SOFLE_DONGLE || SHIELD_SOFLE_LEFT_PERIPHERAL

config ZMK_SPLIT
    default y

endif
```

## boards/shields/sofle/Kconfig.shield
```kconfig
config SHIELD_SOFLE_LEFT_PERIPHERAL
    def_bool $(shields_list_contains,sofle_left_peripheral)

config SHIELD_SOFLE_DONGLE
    def_bool $(shields_list_contains,sofle_dongle)
```

## config/west.yml
```yaml
manifest:

  defaults:
    revision: v0.2

  remotes:
    # Default ZMK
    - name: zmkfirmware
      url-base: https://github.com/zmkfirmware
    # dongle_display
    - name: kiwikey
      url-base: https://github.com/kiwikey
    - name: englmaxi
      url-base: https://github.com/englmaxi
    # support nice_oled and nice_epaper
    - name: mctechnology17
      url-base: https://github.com/mctechnology17

  projects:
    # Default ZMK
    - name: zmk
      remote: zmkfirmware
      import: app/west.yml
    # dongle_display
    - name: zmk-dongle-display
      remote: englmaxi
      revision: main
    # support nice_oled and nice_epaper
    - name: zmk-nice-oled
      remote: mctechnology17
      revision: main

  self:
    path: config
```
